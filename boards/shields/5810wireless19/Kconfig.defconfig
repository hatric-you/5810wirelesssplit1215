## boards/shields/5810wireless19/Kconfig.defconfig
```kconfig
if SHIELD_5810WIRELESS19_RIGHT

config ZMK_KEYBOARD_NAME
    default "5810wireless19"

endif

if SHIELD_5810WIRELESS19_LEFT || SHIELD_5810WIRELESS19_RIGHT

config ZMK_SPLIT
    default y

endif
```

## boards/shields/5810wireless19/Kconfig.shield
```kconfig
config SHIELD_5810WIRELESS19_LEFT
    def_bool $(shields_list_contains,5810wireless19_left)
config SHIELD_5810WIRELESS19_RIGHT
    def_bool $(shields_list_contains,5810wireless19_right)
```
